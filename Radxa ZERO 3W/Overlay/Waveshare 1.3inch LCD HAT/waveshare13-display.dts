/dts-v1/;
/plugin/;

#include <dt-bindings/gpio/gpio.h>
#include <dt-bindings/pinctrl/rockchip.h>
#include <dt-bindings/interrupt-controller/irq.h>

/ {
	metadata {
		title = "Waveshare 1.3inch LCD HAT Display";
		compatible = "radxa,zero3";
		category = "misc";
		description = "Waveshare 1.3inch LCD HAT For Radxa Zero 3W. This is the display part of the screen overlay.";
	};
};

&spi3{
	status = "okay";
	pinctrl-names = "default", "high_speed";
	pinctrl-0 = <&spi3m1_cs0 &spi3m1_pins>;
	pinctrl-1 = <&spi3m1_cs0 &spi3m1_pins_hs>;

	st7789v@0 {
		compatible = "sitronix,st7789v";
		reg = <0>; //chip select 0:cs0  1:cs1
		spi-max-frequency = <10000000>;
		rotate = <90>; //横屏90度旋转
		fps = <30>; //帧率
		buswidth = <8>; //数据线宽
		regwidth = <8>; //寄存器数据线宽
		width = <240>;
		height = <240>;
		cs-gpio = <&gpio4 RK_PC6 GPIO_ACTIVE_HIGH>; //片选 GPIO4 C6
		dc-gpios = <&gpio3 RK_PC1 GPIO_ACTIVE_HIGH>; //DC脚 GPIO3 C1
		reset-gpios = <&gpio3 RK_PA2 GPIO_ACTIVE_LOW>; //rest脚 GPIO3 A2
		debug = <0>;
    };
};